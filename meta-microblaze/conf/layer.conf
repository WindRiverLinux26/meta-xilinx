## meta-vitis-tc/conf/layer.conf
```bitbake
# We have a conf and classes directory, add to BBPATH
BBPATH .= ":${LAYERDIR}"

# Keep layer path so recipes can reference it
VITIS_TC_PATH = "${LAYERDIR}"

# We have a packages directory, add to BBFILES
BSP_XILINX_DERIVED ??= ""
BBFILES += "${@bb.utils.contains_any('MACHINE', '${BSP_XILINX_DERIVED}', '${LAYERDIR}/recipes-*/*/*.bb', '', d)}"
BBFILES += "${@bb.utils.contains_any('MACHINE', '${BSP_XILINX_DERIVED}', '${LAYERDIR}/recipes-*/*/*.bbappend', '', d)}"

BBFILE_COLLECTIONS += "vitis-tc"
BBFILE_PRIORITY_vitis-tc = "6"

LAYERSUMMARY_vitis-tc = "AMD Vitis baremetal cross-toolchain machines"
LAYERDESCRIPTION_vitis-tc = "Layer providing baremetal cross-toolchain \
machine .conf files (AArch32, AArch64, Cortex-R/M, MicroBlaze, \
MicroBlaze-V) and supporting recipes for AMD Vitis embedded software \
flows."
BBFILE_PATTERN_vitis-tc := "^${LAYERDIR}/"

LAYERDEPENDS_vitis-tc = "\
    core \
    xilinx \
    xilinx-microblaze \
    xilinx-standalone \
    "

LAYERSERIES_COMPAT_vitis-tc = "scarthgap whinlatter"
```

## meta-xilinx-bsp/conf/layer.conf
```bitbake
# We have a conf and classes directory, add to BBPATH
BBPATH .= ":${LAYERDIR}"

# We have a packages directory, add to BBFILES
BSP_XILINX_DERIVED ??= ""
BBFILES += "${@bb.utils.contains_any('MACHINE', '${BSP_XILINX_DERIVED}', '${LAYERDIR}/recipes-*/*/*.bb', '', d)}"
BBFILES += "${@bb.utils.contains_any('MACHINE', '${BSP_XILINX_DERIVED}', '${LAYERDIR}/recipes-*/*/*.bbappend', '', d)}"

BBFILE_COLLECTIONS += "xilinx-bsp"
BBFILE_PATTERN_xilinx-bsp = "^${LAYERDIR}/"
BBFILE_PRIORITY_xilinx-bsp = "5"

LAYERSUMMARY_xilinx-bsp = "AMD Xilinx core BSP (Versal/Zynq/MicroBlaze \
evaluation boards)"
LAYERDESCRIPTION_xilinx-bsp = "BSP layer providing the supported AMD \
Xilinx evaluation board machine configurations (Versal \
VCK/VEK/VMK/VPK/VRK, Versal Gen 2, Zynq UltraScale+, Zynq-7000, \
MicroBlaze)."
BBFILE_PATTERN_IGNORE_EMPTY_xilinx-bsp = "1"

LAYERDEPENDS_xilinx-bsp = "xilinx"

LAYERSERIES_COMPAT_xilinx-bsp = "scarthgap wrynose"
```

## meta-xilinx-gpu-malig78ae/conf/layer.conf
```bitbake
# We have a conf and classes directory, add to BBPATH
BBPATH .= ":${LAYERDIR}"

# We have a packages directory, add to BBFILES
BSP_XILINX_DERIVED ??= ""
BBFILES += "${@bb.utils.contains_any('MACHINE', '${BSP_XILINX_DERIVED}', '${LAYERDIR}/recipes-*/*/*.bb', '', d)}"
BBFILES += "${@bb.utils.contains_any('MACHINE', '${BSP_XILINX_DERIVED}', '${LAYERDIR}/recipes-*/*/*.bbappend', '', d)}"

BBFILE_COLLECTIONS += "xilinx-gpu-malig78ae"
BBFILE_PATTERN_xilinx-gpu-malig78ae = "^${LAYERDIR}/"
BBFILE_PRIORITY_xilinx-gpu-malig78ae = "5"

LAYERSUMMARY_xilinx-gpu-malig78ae = "AMD Versal Gen 2 Mali G78AE GPU \
support"
LAYERDESCRIPTION_xilinx-gpu-malig78ae = "GPU integration layer for the \
Mali G78AE block on AMD Versal Series Gen 2 SoCs (kernel driver, \
userspace libraries, and Wayland/X11 glue)."

# We use the mali400 layer to fill in some libmali-xlnx dependencies
LAYERDEPENDS_xilinx-gpu-malig78ae = " \
    core \
    xilinx \
    xilinx-mali400 \
    "

LAYERSERIES_COMPAT_xilinx-gpu-malig78ae = "scarthgap whinlatter"

INHERIT += "${@bb.utils.contains_any('MACHINE', '${BSP_XILINX_DERIVED}', 'sanity-meta-xilinx-gpu-malig78ae', '', d)}"

META_XILINX_MALIG78AE_CONFIG_PATH = "${LAYERDIR}/conf/distro/include/meta-xilinx-gpu-malig78ae-default-versions.inc"

USER_CLASSES:append = "${@bb.utils.contains_any('MACHINE', '${BSP_XILINX_DERIVED}', ' meta-xilinx-gpu-malig78ae-cfg', '', d)}"
```

## meta-xilinx-mali400/conf/layer.conf
```bitbake
# We have a conf and classes directory, add to BBPATH
BBPATH .= ":${LAYERDIR}"

# We have a packages directory, add to BBFILES
BSP_XILINX_DERIVED ??= ""
BBFILES += "${@bb.utils.contains_any('MACHINE', '${BSP_XILINX_DERIVED}', '${LAYERDIR}/recipes-*/*/*.bb', '', d)}"
BBFILES += "${@bb.utils.contains_any('MACHINE', '${BSP_XILINX_DERIVED}', '${LAYERDIR}/recipes-*/*/*.bbappend', '', d)}"

BBFILES_DYNAMIC += " \
    openembedded-layer:${LAYERDIR}/dynamic-layers/openembedded-layer/recipes-*/*/*.bb \
    openembedded-layer:${LAYERDIR}/dynamic-layers/openembedded-layer/recipes-*/*/*.bbappend \
    qt5-layer:${LAYERDIR}/dynamic-layers/qt5-layer/recipes-*/*/*.bb \
    qt5-layer:${LAYERDIR}/dynamic-layers/qt5-layer/recipes-*/*/*.bbappend \
    ros-common-layer:${LAYERDIR}/dynamic-layers/meta-ros/meta-ros-common/recipes-*/*/*.bb \
    ros-common-layer:${LAYERDIR}/dynamic-layers/meta-ros/meta-ros-common/recipes-*/*/*.bbappend \
    ros2-jazzy-layer:${LAYERDIR}/dynamic-layers/meta-ros/meta-ros2-jazzy/recipes-*/*/*.bb \
    ros2-jazzy-layer:${LAYERDIR}/dynamic-layers/meta-ros/meta-ros2-jazzy/recipes-*/*/*.bbappend \
    xilinx-multimedia:${LAYERDIR}/dynamic-layers/xilinx-multimedia/recipes-*/*/*.bb \
    xilinx-multimedia:${LAYERDIR}/dynamic-layers/xilinx-multimedia/recipes-*/*/*.bbappend \
"

BBFILE_COLLECTIONS += "xilinx-mali400"
BBFILE_PATTERN_xilinx-mali400 = "^${LAYERDIR}/"
BBFILE_PRIORITY_xilinx-mali400 = "5"

LAYERSUMMARY_xilinx-mali400 = "AMD Zynq UltraScale+ Mali-400 GPU \
support"
LAYERDESCRIPTION_xilinx-mali400 = "GPU integration layer for the \
Mali-400 block on AMD Zynq UltraScale+ MPSoC SoCs, including the \
libmali userspace driver and Wayland/X11 enablement."

LAYERDEPENDS_xilinx-mali400 = " \
    core \
    xilinx \
    "

LAYERSERIES_COMPAT_xilinx-mali400 = "scarthgap whinlatter"

INHERIT += "${@bb.utils.contains_any('MACHINE', '${BSP_XILINX_DERIVED}', 'sanity-meta-xilinx-mali400', '', d)}"

META_XILINX_MALI400_CONFIG_PATH = "${LAYERDIR}/conf/distro/include/meta-xilinx-mali400-default-versions.inc"

USER_CLASSES:append = "${@bb.utils.contains_any('MACHINE', '${BSP_XILINX_DERIVED}', ' meta-xilinx-mali400-cfg', '', d)}"

# We can't use BSP_XILINX_DERIVED for BBFILES_DYNAMIC because BSP_XILINX_DERIVED
# has not been assigned when parsing BBFILES_DYNAMIC.
BBMASK += "${@bb.utils.contains_any('MACHINE', '${BSP_XILINX_DERIVED}', '', '${LAYERDIR}/dynamic-layers/', d)}"
```
